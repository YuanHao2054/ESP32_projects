## esp32s3/esp32s3_hx8369/sdkconfig.defaults
```kconfig
#
# Serial flasher config
#
CONFIG_ESPTOOLPY_FLASHFREQ_120M=y

#
# Compiler options
#
CONFIG_COMPILER_OPTIMIZATION_PERF=y


#
# LCD Peripheral Configuration
#
CONFIG_LCD_PANEL_IO_FORMAT_BUF_SIZE=192


#
# ESP PSRAM
#
CONFIG_SPIRAM=y

CONFIG_SPIRAM_SPEED_120M=y



#
# FAT Filesystem support
#
CONFIG_FATFS_LFN_STACK=y
CONFIG_FATFS_MAX_LFN=255
CONFIG_FATFS_API_ENCODING_UTF_8=y
CONFIG_FATFS_ALLOC_PREFER_EXTRAM=y



#
# Kernel
#
CONFIG_FREERTOS_HZ=1000
   
#
# SNTP
#
CONFIG_LWIP_SNTP_MAX_SERVERS=4

#
# FreeRTOS
#
CONFIG_FREERTOS_USE_TRACE_FACILITY=y
CONFIG_FREERTOS_USE_STATS_FORMATTING_FUNCTIONS=y
CONFIG_FREERTOS_VTASKLIST_INCLUDE_COREID=y
CONFIG_FREERTOS_GENERATE_RUN_TIME_STATS=y


#
# Cache config
#
CONFIG_ESP32S3_DATA_CACHE_LINE_64B=y


#
# LVGL configuration
#
CONFIG_LV_MEM_CUSTOM=y
CONFIG_LV_MEMCPY_MEMSET_STD=y
CONFIG_LV_USE_LARGE_COORD=y
CONFIG_LV_ATTRIBUTE_FAST_MEM_USE_IRAM=y
```
